## CMakeLists.txt
```
#-------------------------------------------------------------------------------
# Zephyr Example Application
#
# Copyright (c) 2021 Nordic Semiconductor ASA
# SPDX-License-Identifier: Apache-2.0

cmake_minimum_required(VERSION 3.13.1)

# This workspace does not assume a Zephyr SDK is installed. Default to the
# system arm-none-eabi toolchain (gnuarmemb) so the SAM D21/R21 boards build
# out of the box. Still overridable via -DZEPHYR_TOOLCHAIN_VARIANT=... or the
# environment.
if(NOT DEFINED ZEPHYR_TOOLCHAIN_VARIANT AND NOT DEFINED ENV{ZEPHYR_TOOLCHAIN_VARIANT})
  set(ZEPHYR_TOOLCHAIN_VARIANT gnuarmemb)
endif()

find_package(Zephyr REQUIRED HINTS $ENV{ZEPHYR_BASE})

project(gateway LANGUAGES C)

target_sources(app PRIVATE src/main.c src/radio_socket.c src/http_server.c)
zephyr_linker_sources(SECTIONS sections-rom.ld)

# The code below locates the git index file for this repository and adds it as a dependency for
# the application VERSION file so that if the repo has a new commit added, even if no files in
# the build have changed, the application version file will be regenerated with the new git commit
find_package(Git QUIET)
if(GIT_FOUND)
  execute_process(
    COMMAND ${GIT_EXECUTABLE} rev-parse --absolute-git-dir
    WORKING_DIRECTORY .
    OUTPUT_VARIABLE application_git_dir
    OUTPUT_STRIP_TRAILING_WHITESPACE
    ERROR_STRIP_TRAILING_WHITESPACE
    ERROR_VARIABLE stderr
    RESULT_VARIABLE return_code
  )
  # If there is an error e.g. it is not a git repo, we just silently ignore it and continue
  # without a dependency, this will be the case with freestanding applications.
  if(NOT return_code)
    if(NOT "${stderr}" STREQUAL "")
      message(WARNING "Application build version git rev-parse warned: ${stderr}")
    endif()

    set_property(TARGET app_version_h PROPERTY APP_VERSION_DEPENDS ${application_git_dir}/index)
  endif()
endif()
```

## Kconfig
```
# Copyright (c) 2021 Nordic Semiconductor ASA
# SPDX-License-Identifier: Apache-2.0
#
# This file is the application Kconfig entry point. All application Kconfig
# options can be defined here or included via other application Kconfig files.
# You can browse these options using the west targets menuconfig (terminal) or
# guiconfig (GUI).

menu "Zephyr"
source "Kconfig.zephyr"
endmenu

module = GATEWAY
module-str = GATEWAY
source "subsys/logging/Kconfig.template.log_config"

config GATEWAY_NODE_ONLINE_TIMEOUT_MS
	int "Maximum reception age for an online sensor node (ms)"
	default 30000
	range 1 2147483647
	help
	  Nodes count as online while the age of their last gateway reception
	  is at most this timeout. Adjust for the sensor reporting interval.

config GATEWAY_HTTP_PORT
	int "Gateway HTTP listen port"
	default 80
	range 1 65535
```

## prj.conf
```kconfig
# Copyright (c) 2026
# SPDX-License-Identifier: Apache-2.0
#
# Gateway bring-up image for the SAM R21 Xplained Pro (samr21_xpro only).
# Normal 802.15.4 L2 with a radio-bound raw packet socket for TX and RX.
# Promiscuous mode is enabled so any on-channel frame is accepted; frames
# carrying the 18-byte sensor payload are printed to the console.

CONFIG_NETWORKING=y
CONFIG_IEEE802154=y
CONFIG_IEEE802154_RAW_MODE=n
CONFIG_NET_L2_IEEE802154=y
CONFIG_NET_SOCKETS=y
CONFIG_NET_SOCKETS_PACKET=y
CONFIG_NET_TCP=y
CONFIG_NET_MAX_CONN=1
CONFIG_HTTP_SERVER=y
CONFIG_HTTP_SERVER_VERSION_1=y
CONFIG_HTTP_SERVER_VERSION_2=n
CONFIG_HTTP_SERVER_NUM_SERVICES=1
CONFIG_HTTP_SERVER_MAX_CLIENTS=1
CONFIG_HTTP_SERVER_MAX_STREAMS=1
CONFIG_HTTP_SERVER_CLIENT_BUFFER_SIZE=128
CONFIG_HTTP_SERVER_MAX_URL_LENGTH=64
CONFIG_HTTP_SERVER_STACK_SIZE=2048
CONFIG_IEEE802154_NET_IF_NO_AUTO_START=y
# Codec consumes complete MAC frames without the hardware-generated FCS.
CONFIG_IEEE802154_L2_PKT_INCL_FCS=n
# Decode/print now runs in an application thread, not the driver RX thread.
CONFIG_IEEE802154_RF2XX_RX_STACK_SIZE=2048
CONFIG_NET_PKT_TX_COUNT=2
CONFIG_NET_PKT_RX_COUNT=8
# Eight 256-byte fragments can hold a full Ethernet frame alongside radio traffic.
CONFIG_NET_BUF_RX_COUNT=8
CONFIG_NET_BUF_TX_COUNT=8
CONFIG_NET_BUF_DATA_SIZE=256
CONFIG_SPI=y
CONFIG_NET_L2_ETHERNET=y
CONFIG_ETH_DRIVER=y
CONFIG_ETHERNET_LOG_LEVEL_INF=y
CONFIG_NET_MGMT_EVENT=y
CONFIG_NET_MGMT_EVENT_SYSTEM_WORKQUEUE=y
CONFIG_NET_IPV4=y
# Radio and Ethernet each need an IPv4 configuration slot.
CONFIG_NET_IF_MAX_IPV4_COUNT=2
CONFIG_NET_DHCPV4=y
CONFIG_NET_IPV4_MAX_ROUTES=2
CONFIG_NET_MAX_CONTEXTS=3
CONFIG_NET_IPV6=n
CONFIG_RADIO=y
CONFIG_GATEWAY_MEMORY=y
CONFIG_GATEWAY_JSON=y
CONFIG_REBOOT=y
CONFIG_LOG=y
CONFIG_LOG_BUFFER_SIZE=512
# Main also runs device/network initialization and deferred-log packaging.
CONFIG_ISR_STACK_SIZE=1024
CONFIG_MAIN_STACK_SIZE=2048
CONFIG_INIT_STACKS=y
CONFIG_THREAD_STACK_INFO=y
CONFIG_STACK_SENTINEL=y
# rf2xx CSMA backoff needs rand; no TRNG driver on this board, use test RNG
CONFIG_TEST_RANDOM_GENERATOR=y
```

## src/main.c
```c
/*
 * Copyright (c) 2026
 * SPDX-License-Identifier: Apache-2.0
 *
 * Gateway bring-up image for samr21_xpro.
 *
 * Raw-socket 802.15.4 receiver: the radio is brought up promiscuous on
 * channel 15 with our PAN ID (0xCAFE) set in the hardware filter. Frames whose
 * MAC payload is
 * exactly the 18-byte sensor payload decode via sensor_frame_decode() and
 * are printed to the console; anything else is just counted.
 */

#include <zephyr/kernel.h>
#include <zephyr/device.h>
#include <zephyr/init.h>
#include <zephyr/logging/log.h>

#include <zephyr/net/net_if.h>
#include <zephyr/net/ieee802154_radio.h>
#include <zephyr/net/ieee802154.h>
#include <zephyr/net/ieee802154_mgmt.h>
#include <zephyr/net/ethernet_mgmt.h>
#include <zephyr/net/net_mgmt.h>
#include <zephyr/net/dhcpv4.h>
#include <zephyr/sys/atomic.h>
#include "radio_socket.h"
#include "gateway_state.h"
#include "http_server.h"

#include <app/lib/sensor_frame.h>
#include <app/gateway/memory_table.h>
#include <app/gateway/sensors_json.h>
#include <app/gateway/sensors_response.h>

#include <zephyr/app_version.h>

LOG_MODULE_REGISTER(gateway, CONFIG_GATEWAY_LOG_LEVEL);

#define GW_CHANNEL 15
#define GW_PAN_ID  0xCAFE

static const struct device *const radio =
	DEVICE_DT_GET(DT_CHOSEN(zephyr_ieee802154));

static struct gateway_memory gateway_memory;
static atomic_t rx_ok;
static atomic_t rx_other;
static struct radio_socket radio_sock = { .fd = -1 };
static K_SEM_DEFINE(rx_ready, 0, 1);

/* Ethernet link monitor: logs carrier up/down and current IPv4 address. */
static void eth_event_handler(struct net_mgmt_event_callback *cb,
			      uint64_t event, struct net_if *iface)
{
	char addr[NET_IPV4_ADDR_LEN];
	ARG_UNUSED(cb);
	if (net_if_l2(iface) != &NET_L2_GET_NAME(ETHERNET)) {
		return;
	}
	if (event == NET_EVENT_ETHERNET_CARRIER_ON) {
		LOG_INF("eth: carrier on");
	} else if (event == NET_EVENT_ETHERNET_CARRIER_OFF) {
		LOG_WRN("eth: carrier off");
	} else if (event == NET_EVENT_IPV4_ADDR_ADD) {
		struct net_in_addr *ip = net_if_ipv4_get_global_addr(iface,
								 NET_ADDR_PREFERRED);

		if (ip != NULL && net_addr_ntop(AF_INET, ip, addr, sizeof(addr)) != NULL) {
			LOG_INF("eth: ipv4 %s", addr);
		}
	}
}

static struct net_mgmt_event_callback eth_cb;
static struct net_if *eth_iface;

/* Run after device/network initialization and before the application threads. */
static int eth_setup(void)
{
	net_mgmt_init_event_callback(&eth_cb, eth_event_handler,
				     NET_EVENT_ETHERNET_CARRIER_ON |
				     NET_EVENT_ETHERNET_CARRIER_OFF |
				     NET_EVENT_IPV4_ADDR_ADD);
	net_mgmt_add_event_callback(&eth_cb);
	eth_iface = net_if_get_first_by_type(&NET_L2_GET_NAME(ETHERNET));
	if (eth_iface == NULL) {
		LOG_WRN("eth: no ethernet interface, monitor idle");
		return -ENODEV;
	}
	if (!device_is_ready(net_if_get_device(eth_iface))) {
		LOG_ERR("eth: controller initialization failed");
		eth_iface = NULL;
		return -ENODEV;
	}
	if (!net_if_is_admin_up(eth_iface)) {
		int ret = net_if_up(eth_iface);

		if (ret < 0) {
			LOG_ERR("eth: net_if_up failed (%d)", ret);
			eth_iface = NULL;
			return ret;
		}
	}
	net_dhcpv4_start(eth_iface);
	LOG_INF("eth: monitor up, carrier=%s admin=%s",
		net_if_is_carrier_ok(eth_iface) ? "ok" : "down",
		net_if_is_admin_up(eth_iface) ? "up" : "down");
	return 0;
}

SYS_INIT(eth_setup, APPLICATION, CONFIG_APPLICATION_INIT_PRIORITY);

static K_MUTEX_DEFINE(gateway_memory_lock);

int gateway_sensors_json_response(char *output, size_t capacity)
{
	return gateway_sensors_json_encode(&gateway_memory, &gateway_memory_lock,
					   output, capacity);
}

/* Fornece ao handler HTTP um snapshot da tabela protegida pelo mutex global. */
int gateway_sensors_json_stream_start(struct gateway_sensors_json_stream *stream)
{
	return gateway_sensors_json_stream_init(&gateway_memory, &gateway_memory_lock,
						stream);
}

int gateway_get_health_stats(struct gateway_memory_stats *stats)
{
	int ret;

	if (stats == NULL) {
		return -EINVAL;
	}

	k_mutex_lock(&gateway_memory_lock, K_FOREVER);
	ret = gateway_memory_get_stats(&gateway_memory, k_uptime_get_32(),
				       CONFIG_GATEWAY_NODE_ONLINE_TIMEOUT_MS, stats);
	k_mutex_unlock(&gateway_memory_lock);

	return ret;
}

/* Runs in the RX thread; console output uses a copy outside the table lock. */
static void handle_sensor_reading(const struct sensor_reading *r)
{
	struct gateway_memory_entry entry;
	int ret;
	int get_ret;

	k_mutex_lock(&gateway_memory_lock, K_FOREVER);
	ret = gateway_memory_update(&gateway_memory, r, k_uptime_get_32());
	get_ret = gateway_memory_get(&gateway_memory, r->node_id, &entry);
	k_mutex_unlock(&gateway_memory_lock);

	if (ret < 0) {
		LOG_WRN("Memory update for node %u failed (%d)", r->node_id, ret);
	}
	if (get_ret == 0) {
		printk("memory node=%u seq=%u received_at=%u ms\n",
		       entry.reading.node_id, entry.reading.seq,
		       entry.received_at_ms);
	}

	printk("rx node=%u seq=%u light=%u temp_c_x100=%d "
	       "accel=%d,%d,%d uptime=%u flags=%u\n",
	       r->node_id, r->seq, r->light, r->temp_c_x100,
	       r->accel[0], r->accel[1], r->accel[2],
	       r->uptime_ms, r->flags);
}

/*
 * Socket copies the complete frame (including MAC header) out of all packet
 * fragments. Decode/print cannot block the radio driver's RX thread.
 */
static void receive_frames(void *p1, void *p2, void *p3)
{
	struct sensor_reading r;
	uint8_t psdu[RADIO_SOCKET_FRAME_MAX];

	ARG_UNUSED(p1);
	ARG_UNUSED(p2);
	ARG_UNUSED(p3);
	k_sem_take(&rx_ready, K_FOREVER);
	while (true) {
		int len = radio_socket_recv(&radio_sock, psdu, sizeof(psdu), 0);

		if (len < 0 && len != -EMSGSIZE) {
			LOG_ERR("Raw socket receive failed (%d)", len);
			k_sleep(K_MSEC(100));
			continue;
		}
		if (len >= 0 && sensor_frame_decode(psdu, len, &r) == 0) {
			atomic_inc(&rx_ok);
			handle_sensor_reading(&r);
		} else {
			atomic_inc(&rx_other);
		}
	}
}

K_THREAD_DEFINE(radio_rx_id, 2048, receive_frames, NULL, NULL, NULL, 5, 0, 0);

static void gateway_run(void *p1, void *p2, void *p3)
{
	const struct ieee802154_radio_api *api;
	struct net_if *iface;
	uint16_t channel = GW_CHANNEL;
	int ret;

	ARG_UNUSED(p1);
	ARG_UNUSED(p2);
	ARG_UNUSED(p3);

	printk("Gateway %s (samr21_xpro, ch %d, pan 0x%04x, promiscuous)\n",
	       APP_VERSION_STRING, GW_CHANNEL, GW_PAN_ID);

	if (!device_is_ready(radio)) {
		LOG_ERR("Radio not ready");
		return;
	}

	api = (const struct ieee802154_radio_api *)radio->api;
	iface = net_if_lookup_by_dev(radio);
	ret = radio_socket_open(&radio_sock, iface);
	if (ret < 0) {
		LOG_ERR("Raw socket open failed (%d)", ret);
		return;
	}
	/* Set both L2 state and hardware: L2 refuses to start without a channel. */
	ret = net_mgmt(NET_REQUEST_IEEE802154_SET_CHANNEL, iface, &channel, sizeof(channel));
	if (ret < 0) {
		LOG_ERR("set_channel(%d) failed (%d)", GW_CHANNEL, ret);
		radio_socket_close(&radio_sock);
		return;
	}

	/* Our PAN ID, in the hardware filter. Promiscuous mode below accepts
	 * everything regardless for now; the ID is set so the filter is ready
	 * when we stop being promiscuous.
	 */
	{
		struct ieee802154_filter f = { .pan_id = GW_PAN_ID };

		ret = api->filter(radio, true, IEEE802154_FILTER_TYPE_PAN_ID, &f);
		if (ret < 0) {
			LOG_WRN("PAN ID filter refused (%d), continuing", ret);
		}
	}

	/* Promiscuous for now: accept any on-channel frame. */
	{
		struct ieee802154_config cfg = { .promiscuous = true };

		ret = api->configure(radio, IEEE802154_CONFIG_PROMISCUOUS, &cfg);
		if (ret < 0) {
			LOG_WRN("Promiscuous mode refused (%d), using default filter",
				ret);
		}
	}

	ret = net_if_up(iface);
	if (ret < 0) {
		LOG_ERR("Radio interface up failed (%d)", ret);
		radio_socket_close(&radio_sock);
		return;
	}
	k_sem_give(&rx_ready);

	LOG_INF("Listening promiscuous on ch %d, PAN ID 0x%04x set", GW_CHANNEL, GW_PAN_ID);

	unsigned int ticks = 0;

	while (1) {
		struct gateway_memory_stats stats;

		k_sleep(K_MSEC(5000));
		ticks++;
		k_mutex_lock(&gateway_memory_lock, K_FOREVER);
		gateway_memory_get_stats(&gateway_memory, k_uptime_get_32(),
					 CONFIG_GATEWAY_NODE_ONLINE_TIMEOUT_MS, &stats);
		k_mutex_unlock(&gateway_memory_lock);

		LOG_INF("gw ok=%u other=%u stored=%u active=%u",
			(unsigned int)atomic_get(&rx_ok),
			(unsigned int)atomic_get(&rx_other),
			(unsigned int)stats.valid_nodes, (unsigned int)stats.online_nodes);
		if (eth_iface != NULL && (ticks % 2) == 0) {
			LOG_INF("eth: carrier=%s admin=%s",
				net_if_is_carrier_ok(eth_iface) ? "ok" : "down",
				net_if_is_admin_up(eth_iface) ? "up" : "down");
		}
	}

}

K_THREAD_DEFINE(gateway_id, 1024, gateway_run, NULL, NULL, NULL, 0, 0, 0);

int main(void)
{
	int ret = gateway_http_server_start();

	if (ret < 0) {
		return ret;
	}

	return 0;
}
```

## src/gateway_state.h
```c
/*
 * SPDX-License-Identifier: Apache-2.0
 */

#ifndef GATEWAY_STATE_H_
#define GATEWAY_STATE_H_

#include <app/gateway/memory_table.h>

int gateway_get_health_stats(struct gateway_memory_stats *stats);

#endif /* GATEWAY_STATE_H_ */
```

## src/http_server.c
```c
/*
 * Copyright (c) 2026
 * SPDX-License-Identifier: Apache-2.0
 */

#include <errno.h>
#include <stddef.h>
#include <stdint.h>

#include <zephyr/kernel.h>
#include <zephyr/logging/log.h>
#include <zephyr/net/http/server.h>
#include <zephyr/net/http/service.h>
#include <zephyr/sys/reboot.h>

#include <app/gateway/memory_table.h>
#include <app/gateway/sensors_response.h>

#include "gateway_state.h"
#include "http_server.h"

LOG_MODULE_REGISTER(gateway_http, CONFIG_GATEWAY_LOG_LEVEL);

static uint16_t gateway_http_port = 80;
/* O HTTP/1 chama o handler novamente até final_chunk; o limite é um cliente. */
static struct gateway_sensors_json_stream gateway_sensors_stream;
static char gateway_sensors_http_chunk[GATEWAY_SENSORS_JSON_CHUNK_SIZE];
static bool gateway_sensors_stream_active;

static void gateway_reset_work_handler(struct k_work *work)
{
	ARG_UNUSED(work);
	sys_reboot(SYS_REBOOT_COLD);
}

static K_WORK_DELAYABLE_DEFINE(gateway_reset_work, gateway_reset_work_handler);

static void gateway_http_set_response(struct http_response_ctx *response_ctx,
				      enum http_status status,
				      const char *body, size_t body_len)
{
	response_ctx->status = status;
	response_ctx->body = (const uint8_t *)body;
	response_ctx->body_len = body_len;
	response_ctx->final_chunk = true;
}

static int gateway_sensors_http_handler(struct http_client_ctx *client,
					enum http_transaction_status status,
					const struct http_request_ctx *request_ctx,
					struct http_response_ctx *response_ctx,
					void *user_data)
{
	static const char error_body[] = "{\"error\":\"could not encode sensor data\"}";
	bool final_chunk;
	int ret;

	ARG_UNUSED(client);
	ARG_UNUSED(request_ctx);
	ARG_UNUSED(user_data);

	if (status == HTTP_SERVER_TRANSACTION_COMPLETE ||
	    status == HTTP_SERVER_TRANSACTION_ABORTED) {
		/* Descarta o estado, seja após concluir a resposta ou abortar a conexão. */
		gateway_sensors_stream_active = false;
		return 0;
	}
	if (status != HTTP_SERVER_REQUEST_DATA_FINAL) {
		return 0;
	}

	if (!gateway_sensors_stream_active) {
		/* Todas as partes da resposta usam a mesma cópia da tabela. */
		ret = gateway_sensors_json_stream_start(&gateway_sensors_stream);
		if (ret < 0) {
			LOG_ERR("Could not snapshot sensor data (%d)", ret);
			gateway_http_set_response(response_ctx, HTTP_500_INTERNAL_SERVER_ERROR,
					  error_body, sizeof(error_body) - 1U);
			return 0;
		}
		gateway_sensors_stream_active = true;
	}

	ret = gateway_sensors_json_encode_next(&gateway_sensors_stream,
					       gateway_sensors_http_chunk,
					       sizeof(gateway_sensors_http_chunk),
					       &final_chunk);
	if (ret < 0) {
		LOG_ERR("Could not encode sensor data chunk (%d)", ret);
		gateway_sensors_stream_active = false;
		return ret;
	}

	gateway_http_set_response(response_ctx, HTTP_200_OK,
				  gateway_sensors_http_chunk, (size_t)ret);
	response_ctx->final_chunk = final_chunk;
	return 0;
}

static struct http_resource_detail_dynamic gateway_sensors_resource = {
	.common = {
		.type = HTTP_RESOURCE_TYPE_DYNAMIC,
		.bitmask_of_supported_http_methods = BIT(HTTP_GET),
		.content_type = "application/json",
	},
	.cb = gateway_sensors_http_handler,
};

static int gateway_health_http_handler(struct http_client_ctx *client,
				       enum http_transaction_status status,
				       const struct http_request_ctx *request_ctx,
				       struct http_response_ctx *response_ctx,
				       void *user_data)
{
	static char body[80];
	struct gateway_memory_stats stats;
	uint32_t uptime_ms;
	int ret;

	ARG_UNUSED(client);
	ARG_UNUSED(request_ctx);
	ARG_UNUSED(user_data);

	if (status != HTTP_SERVER_REQUEST_DATA_FINAL) {
		return 0;
	}

	ret = gateway_get_health_stats(&stats);
	if (ret < 0) {
		LOG_ERR("Could not read gateway health statistics (%d)", ret);
		return ret;
	}

	uptime_ms = k_uptime_get_32();
	ret = snprintk(body, sizeof(body),
		       "status=running\nuptime_ms=%u\nonline_nodes=%u\n",
		       (unsigned int)uptime_ms, (unsigned int)stats.online_nodes);
	if (ret < 0 || (size_t)ret >= sizeof(body)) {
		return -ENOMEM;
	}

	gateway_http_set_response(response_ctx, HTTP_200_OK, body, (size_t)ret);
	return 0;
}

static struct http_resource_detail_dynamic gateway_health_resource = {
	.common = {
		.type = HTTP_RESOURCE_TYPE_DYNAMIC,
		.bitmask_of_supported_http_methods = BIT(HTTP_GET),
		.content_type = "text/plain",
	},
	.cb = gateway_health_http_handler,
};

static int gateway_reset_http_handler(struct http_client_ctx *client,
				      enum http_transaction_status status,
				      const struct http_request_ctx *request_ctx,
				      struct http_response_ctx *response_ctx,
				      void *user_data)
{
	static const char body[] = "Gateway restart scheduled.\n";
	int ret;

	ARG_UNUSED(client);
	ARG_UNUSED(request_ctx);
	ARG_UNUSED(user_data);

	if (status != HTTP_SERVER_REQUEST_DATA_FINAL) {
		return 0;
	}

	ret = k_work_schedule(&gateway_reset_work, K_MSEC(500));
	if (ret < 0) {
		LOG_ERR("Could not schedule gateway restart (%d)", ret);
		return ret;
	}

	gateway_http_set_response(response_ctx, HTTP_202_ACCEPTED,
				  body, sizeof(body) - 1U);
	return 0;
}

static struct http_resource_detail_dynamic gateway_reset_resource = {
	.common = {
		.type = HTTP_RESOURCE_TYPE_DYNAMIC,
		.bitmask_of_supported_http_methods = BIT(HTTP_POST),
		.content_type = "text/plain",
	},
	.cb = gateway_reset_http_handler,
};

HTTP_SERVICE_DEFINE(gateway_http_service, NULL, &gateway_http_port, 1, 2,
		    NULL, NULL, NULL);

HTTP_RESOURCE_DEFINE(gateway_sensors_http_resource, gateway_http_service,
		     "/sensors", &gateway_sensors_resource);
HTTP_RESOURCE_DEFINE(gateway_health_http_resource, gateway_http_service,
		     "/health", &gateway_health_resource);
HTTP_RESOURCE_DEFINE(gateway_reset_http_resource, gateway_http_service,
		     "/reset", &gateway_reset_resource);

int gateway_http_server_start(void)
{
	int ret = http_server_start();

	if (ret < 0) {
		LOG_ERR("HTTP server start failed (%d)", ret);
		return ret;
	}

	LOG_INF("HTTP server listening on port %u", gateway_http_port);
	return 0;
}
```

## src/http_server.h
```c
/*
 * SPDX-License-Identifier: Apache-2.0
 */

#ifndef GATEWAY_HTTP_SERVER_H_
#define GATEWAY_HTTP_SERVER_H_

int gateway_http_server_start(void);

#endif /* GATEWAY_HTTP_SERVER_H_ */
```

## src/radio_socket.c
```c
/* SPDX-License-Identifier: Apache-2.0 */
#include <errno.h>
#include <zephyr/net/ethernet.h>
#include "radio_socket.h"

int radio_socket_open(struct radio_socket *sock, struct net_if *iface)
{
	int ret;

	sock->fd = -1;
	if (iface == NULL || net_if_get_link_addr(iface)->type != NET_LINK_IEEE802154) {
		return -ENODEV;
	}

	sock->addr = (struct sockaddr_ll) {
		.sll_family = AF_PACKET,
		.sll_protocol = htons(ETH_P_ALL),
		.sll_ifindex = net_if_get_by_iface(iface),
	};
	sock->fd = zsock_socket(AF_PACKET, SOCK_RAW, htons(ETH_P_ALL));
	if (sock->fd < 0) {
		return -errno;
	}
	if (zsock_bind(sock->fd, (struct sockaddr *)&sock->addr, sizeof(sock->addr)) < 0) {
		ret = -errno;
		radio_socket_close(sock);
		return ret;
	}
	return 0;
}

void radio_socket_close(struct radio_socket *sock)
{
	if (sock->fd >= 0) {
		zsock_close(sock->fd);
		sock->fd = -1;
	}
}

int net_send_raw(struct radio_socket *sock, const uint8_t *psdu, size_t len)
{
	ssize_t ret;

	if (psdu == NULL || len == 0) {
		return -EINVAL;
	}
	if (len > RADIO_SOCKET_FRAME_MAX) {
		return -EMSGSIZE;
	}
	/* Packet sends are atomic: never retry a partial frame as another frame.
	 * Do not wait indefinitely for network buffer availability.
	 */
	ret = zsock_sendto(sock->fd, psdu, len, ZSOCK_MSG_DONTWAIT,
			   (struct sockaddr *)&sock->addr, sizeof(sock->addr));
	return ret < 0 ? -errno : (ret == len ? (int)ret : -EIO);
}

int radio_socket_recv(struct radio_socket *sock, uint8_t *psdu, size_t cap, int flags)
{
	struct iovec iov = { .iov_base = psdu, .iov_len = cap };
	struct msghdr msg = { .msg_iov = &iov, .msg_iovlen = 1 };
	ssize_t ret;

	if (sock->fd < 0) {
		return -EBADF;
	}
	if (psdu == NULL || cap == 0) {
		return -EINVAL;
	}
	/* Packet recvmsg waits with the fd lock held on this Zephyr version.
	 * Poll first, then receive without waiting so idle RX cannot block TX
	 * through the same socket. This transport has exactly one RX consumer.
	 */
	if (!(flags & ZSOCK_MSG_DONTWAIT)) {
		struct zsock_pollfd pfd = { .fd = sock->fd, .events = ZSOCK_POLLIN };

		ret = zsock_poll(&pfd, 1, -1);
		if (ret < 0) {
			return -errno;
		}
		if (pfd.revents & ZSOCK_POLLNVAL) {
			return -EBADF;
		}
		if (pfd.revents & (ZSOCK_POLLERR | ZSOCK_POLLHUP)) {
			return -EIO;
		}
	}
	ret = zsock_recvmsg(sock->fd, &msg, flags | ZSOCK_MSG_DONTWAIT);
	if (ret < 0) {
		return -errno;
	}
	if ((msg.msg_flags & ZSOCK_MSG_TRUNC) || ret > RADIO_SOCKET_FRAME_MAX) {
		return -EMSGSIZE;
	}
	return ret;
}
```

## src/radio_socket.h
```c
/* SPDX-License-Identifier: Apache-2.0 */
#ifndef GATEWAY_RADIO_SOCKET_H_
#define GATEWAY_RADIO_SOCKET_H_

#include <zephyr/net/net_if.h>
#include <zephyr/net/socket.h>

/* Full IEEE 802.15.4 PSDUs, without FCS. Codec APIs remain independent of
 * Zephyr. Open before use; one RX consumer, TX may run in another thread.
 * Close only after both users have stopped. Functions return negative errno.
 */
#define RADIO_SOCKET_FRAME_MAX 125U

struct radio_socket {
	int fd;
	struct sockaddr_ll addr;
};

int radio_socket_open(struct radio_socket *sock, struct net_if *iface);
void radio_socket_close(struct radio_socket *sock);
int net_send_raw(struct radio_socket *sock, const uint8_t *psdu, size_t len);
int radio_socket_recv(struct radio_socket *sock, uint8_t *psdu, size_t cap,
		      int flags);

#endif
```
