## prj.conf
```kconfig
CONFIG_PRINTK=y
CONFIG_LOG=y
CONFIG_LOG_MODE_MINIMAL=y

CONFIG_GPIO=y
CONFIG_SPI=y

# Rede: Ethernet1 (KSZ8851SNL) com IPv4 por DHCP
CONFIG_NETWORKING=y
CONFIG_NET_IPV4=y
CONFIG_NET_IPV6=n
CONFIG_NET_TCP=y
CONFIG_NET_UDP=y
CONFIG_NET_SOCKETS=y

# Hora real pelo NTP.br (servidores por IP, sem DNS)
CONFIG_SNTP=y

# Coletor: GET /sensors no gateway e leitura do JSON
CONFIG_JSON_LIBRARY=y
# Gateway fora do ar não pode segurar o coletor por muito tempo
CONFIG_NET_SOCKETS_CONNECT_TIMEOUT=1500
CONFIG_NET_L2_ETHERNET=y
CONFIG_ETH_DRIVER=y

CONFIG_NET_CONFIG_SETTINGS=y
CONFIG_NET_DHCPV4=y
CONFIG_NET_CONFIG_INIT_TIMEOUT=1

CONFIG_NET_MGMT_EVENT=y
CONFIG_NET_MGMT_EVENT_INFO=y
CONFIG_NET_MGMT_EVENT_STACK_SIZE=768

# SAMD21 tem 32 KB de RAM: pilha de rede enxuta
CONFIG_NET_PKT_RX_COUNT=4
CONFIG_NET_PKT_TX_COUNT=4
CONFIG_NET_BUF_RX_COUNT=8
CONFIG_NET_BUF_TX_COUNT=8
CONFIG_NET_MAX_CONTEXTS=4
CONFIG_NET_MAX_CONN=4
# Timeout de recv no HTTP: um cliente parado não trava o servidor
CONFIG_NET_CONTEXT_RCVTIMEO=y
CONFIG_NET_TCP_WORKQ_STACK_SIZE=768
# Como servidor, a rx_q responde ACK/FIN do TCP descendo até o driver SPI;
# com 1024 B ela estourava ao fechar a conexão HTTP.
CONFIG_NET_RX_STACK_SIZE=1536
CONFIG_NET_TX_STACK_SIZE=1024
CONFIG_SYSTEM_WORKQUEUE_STACK_SIZE=1280

# SAMD21 não tem TRNG; o TCP precisa de números aleatórios (portas, ISN)
CONFIG_TEST_RANDOM_GENERATOR=y

# SD por SPI (IO1) com FAT
CONFIG_SDHC=y
CONFIG_DISK_DRIVERS=y
CONFIG_DISK_ACCESS=y

CONFIG_FILE_SYSTEM=y
CONFIG_FAT_FILESYSTEM_ELM=y
# Nunca formatar o cartão se a montagem falhar (apagaria os dados)
CONFIG_FS_FATFS_MOUNT_MKFS=n
# Cada arquivo aberto reserva ~550 B de RAM: um para gravar e um para o /log
CONFIG_FS_FATFS_NUM_FILES=2
CONFIG_FS_FATFS_NUM_DIRS=1

# POST /reset reinicia a placa
CONFIG_REBOOT=y

CONFIG_MAIN_STACK_SIZE=2048
# O padrão é 2 KB; 1 KB basta para as interrupções (valor usado pelo supervisor)
# e compensa a RAM do NET_RX_STACK_SIZE maior.
CONFIG_ISR_STACK_SIZE=1024
# Sem MPU no SAMD21, estouro de pilha corrompe memória em silêncio; o
# sentinela transforma isso em pânico, e o nome diz qual thread estourou.
CONFIG_STACK_SENTINEL=y
CONFIG_THREAD_NAME=y

# Endereço do gateway. Sem nada descomentado vale o padrão do Kconfig:

# Gateway real (grupo B): IP da serial do gateway, porta 80
CONFIG_SERVIDOR_GATEWAY_ADDR="192.168.0.100"
CONFIG_SERVIDOR_GATEWAY_PORTA=5500

# Reduzir buffers de rede para economizar RAM (SAMD21 tem apenas 32KB)

# --- Teste: IP estatico para isolar DHCP ---
CONFIG_NET_CONFIG_MY_IPV4_ADDR="192.168.0.200"
CONFIG_NET_CONFIG_MY_IPV4_NETMASK="255.255.255.0"
CONFIG_NET_CONFIG_MY_IPV4_GW="192.168.0.1"
CONFIG_NET_DHCPV4=n

CONFIG_ETHERNET_LOG_LEVEL_DBG=y
CONFIG_NET_TCP_WORKQ_STACK_SIZE=2048
```

## src/api_http.c
```c
/*
 * Servidor HTTP mínimo sobre sockets: uma conexão por vez, uma requisição por
 * conexão (Connection: close). O servidor HTTP do Zephyr não cabe folgado nos
 * 32 KB de RAM do SAMD21 junto com a rede e o SD.
 */

#include "api_http.h"
#include "armazenamento.h"
#include <zephyr/fs/fs.h>
#include "tabela.h"

#include <zephyr/kernel.h>
#include <zephyr/net/socket.h>
#include <zephyr/sys/printk.h>
#include <zephyr/sys/reboot.h>
#include <errno.h>
#include <stdio.h>
#include <string.h>

/*
 * O zsock_send() transmite nesta própria thread, descendo pelo TCP até o
 * driver SPI da Ethernet; com 1536 B a pilha estourava na primeira resposta.
 */
#define TAM_PILHA 2048
#define PRIORIDADE 7
#define TIMEOUT_RECV_S 2

K_THREAD_STACK_DEFINE(pilha_http, TAM_PILHA);
static struct k_thread thread_http;

/* Só a primeira linha importa ("GET /health HTTP/1.1"); o resto é descartado */
static char req[128];
static char cabecalho[160];
/* Corpo de qualquer resposta; o maior é o /data com 4 nós (~450 B) */
static char corpo[512];

/* Lê a requisição até a linha em branco que fecha os cabeçalhos */
static size_t ler_requisicao(int sock)
{
	char bloco[64];
	size_t usado = 0;
	uint32_t ultimos = 0;

	for (;;) {
		ssize_t n = zsock_recv(sock, bloco, sizeof(bloco), 0);

		if (n <= 0) {
			break;
		}
		for (ssize_t i = 0; i < n; i++) {
			if (usado < sizeof(req) - 1) {
				req[usado++] = bloco[i];
			}
			ultimos = (ultimos << 8) | (uint8_t)bloco[i];
		}
		/*
		 * Ler até o fim evita fechar com dados pendentes, o que faria o
		 * TCP mandar RST e o cliente perder a resposta.
		 */
		if (ultimos == 0x0d0a0d0a) { /* "\r\n\r\n" */
			break;
		}
	}

	req[usado] = '\0';
	return usado;
}

static void enviar(int sock, const char *buf, size_t tam)
{
	while (tam > 0) {
		ssize_t n = zsock_send(sock, buf, tam, 0);

		if (n <= 0) {
			return;
		}
		buf += n;
		tam -= n;
	}
}

static void responder(int sock, int codigo, const char *motivo, const char *texto)
{
	size_t tam_corpo = strlen(texto);
	int n = snprintf(cabecalho, sizeof(cabecalho),
			 "HTTP/1.1 %d %s\r\n"
			 "Content-Type: application/json\r\n"
			 "Content-Length: %u\r\n"
			 "Connection: close\r\n\r\n",
			 codigo, motivo, (uint32_t)tam_corpo);

	enviar(sock, cabecalho, n);
	enviar(sock, texto, tam_corpo);
}

/* A requisição é "<metodo> <caminho>[?query] HTTP/1.1"? */
static bool rota(const char *metodo, const char *caminho)
{
	size_t lm = strlen(metodo);
	size_t lc = strlen(caminho);
	char fim;

	if (strncmp(req, metodo, lm) != 0 || req[lm] != ' ' ||
	    strncmp(req + lm + 1, caminho, lc) != 0) {
		return false;
	}
	fim = req[lm + 1 + lc];
	return fim == ' ' || fim == '?';
}

static int get_health(int sock)
{
	/* "degraded": no ar, mas sem SD as leituras não estão sendo gravadas */
	snprintf(corpo, sizeof(corpo),
		 "{\"status\":\"%s\",\"uptime_ms\":%u,\"nodes_online\":%d}",
		 armazenamento_ok() ? "ok" : "degraded",
		 (uint32_t)k_uptime_get(), tabela_nos_online());
	responder(sock, 200, "OK", corpo);
	return 200;
}

static int get_data(int sock)
{
	if (tabela_json(corpo, sizeof(corpo)) < 0) {
		responder(sock, 500, "Internal Server Error",
			  "{\"erro\":\"resposta maior que o buffer\"}");
		return 500;
	}
	responder(sock, 200, "OK", corpo);
	return 200;
}


/* Extrai "node" e "n" de "GET /log?node=1&n=5 HTTP/1.1". */
static bool parse_log_query(int *node, int *n)
{
const char *p = strstr(req, "node=");
const char *q;

*node = -1;
*n = 3; /* padrão: últimas 3 linhas */

if (p != NULL) {
*node = (int)strtol(p + 5, NULL, 10);
}
q = strstr(req, "n=");
if (q != NULL) {
int v = (int)strtol(q + 2, NULL, 10);

if (v > 0 && v <= 4) {
*n = v; /* limita a 4: corpo[512] não comporta mais */
}
}
return *node >= 0;
}

/* Lê o CSV em streaming e devolve as últimas N linhas do nó pedido. */
static int get_log(int sock)
{
int node;
int n;
struct fs_file_t arq;
char linha[128];
size_t usado = 0;
int total = 0;
int escritas;
int faltam;
size_t pos = 0;
int ret;

if (!parse_log_query(&node, &n)) {
responder(sock, 400, "Bad Request",
  "{\"erro\":\"use ?node=X&n=N\"}");
return 400;
}

if (!armazenamento_ok()) {
responder(sock, 503, "Service Unavailable",
  "{\"erro\":\"SD indisponivel\"}");
return 503;
}

/* Primeira passada: conta quantas linhas do nó existem no CSV */
fs_file_t_init(&arq);
ret = fs_open(&arq, "/SD:/LEITURAS.CSV", FS_O_READ);
if (ret < 0) {
responder(sock, 500, "Internal Server Error",
  "{\"erro\":\"falha ao abrir o CSV\"}");
return 500;
}

for (;;) {
ssize_t lidos = fs_read(&arq, linha + usado,
sizeof(linha) - usado - 1);

if (lidos <= 0) {
break;
}
usado += lidos;
linha[usado] = '\0';

char *ini = linha;
char *fim;

while ((fim = strchr(ini, '\n')) != NULL) {
*fim = '\0';
char *c1 = strchr(ini, ',');
char *c2 = c1 ? strchr(c1 + 1, ',') : NULL;

if (c2 != NULL &&
    (int)strtol(c2 + 1, NULL, 10) == node) {
total++;
}
ini = fim + 1;
}
usado = strlen(ini);
memmove(linha, ini, usado);
}
fs_close(&arq);

if (total == 0) {
responder(sock, 200, "OK", "[]");
return 200;
}

/* Segunda passada: relê do início e monta o JSON das últimas N */
escritas = total < n ? total : n;
faltam = total - escritas;

fs_file_t_init(&arq);
ret = fs_open(&arq, "/SD:/LEITURAS.CSV", FS_O_READ);
if (ret < 0) {
responder(sock, 500, "Internal Server Error",
  "{\"erro\":\"falha ao reabrir o CSV\"}");
return 500;
}

usado = 0;
pos += snprintf(corpo + pos, sizeof(corpo) - pos, "[");
for (;;) {
ssize_t lidos = fs_read(&arq, linha + usado,
sizeof(linha) - usado - 1);

if (lidos <= 0) {
break;
}
usado += lidos;
linha[usado] = '\0';

char *ini = linha;
char *fim;

while ((fim = strchr(ini, '\n')) != NULL) {
*fim = '\0';
char *c1 = strchr(ini, ',');
char *c2 = c1 ? strchr(c1 + 1, ',') : NULL;

if (c2 != NULL &&
    (int)strtol(c2 + 1, NULL, 10) == node) {
if (faltam > 0) {
faltam--;
} else {
/* Colunas: 0=data_hora, 1=recebido_ms,
 * 2=node_id, 3=light, 4=temp_c,
 * 5=accel_x, 6=accel_y, 7=accel_z,
 * 8=last_seen_ms
 */
int id, light, ax, ay, az, last;
char temp[16];

if (sscanf(ini,
   "%*[^,],%*[^,],%d,%d,%15[^,],"
   "%d,%d,%d,%d",
   &id, &light, temp,
   &ax, &ay, &az, &last) == 7) {
pos += snprintf(
corpo + pos,
sizeof(corpo) - pos,
"%s{\"node_id\":%d,"
"\"light\":%d,"
"\"temp_c\":%s,"
"\"accel\":[%d,%d,%d],"
"\"last_seen_ms\":%d}",
pos == 1 ? "" : ",",
id, light, temp,
ax, ay, az, last);
}
}
}
ini = fim + 1;
}
usado = strlen(ini);
memmove(linha, ini, usado);
}
fs_close(&arq);

pos += snprintf(corpo + pos, sizeof(corpo) - pos, "]");
responder(sock, 200, "OK", corpo);
return 200;
}

/* Retorna true se a requisição pediu para reiniciar a placa */
static bool atender(int sock)
{
	bool reiniciar = false;
	int codigo;

	if (ler_requisicao(sock) == 0) {
		return false;
	}

	if (rota("GET", "/health")) {
		codigo = get_health(sock);
	} else if (rota("GET", "/data")) {
		codigo = get_data(sock);
	} else if (rota("GET", "/log")) {
		codigo = get_log(sock);
	} else if (rota("POST", "/reset")) {
		/* Responde antes: o supervisor precisa saber que o pedido chegou */
		codigo = 200;
		responder(sock, 200, "OK", "{\"status\":\"reiniciando\"}");
		reiniciar = true;
	} else {
		codigo = 404;
		responder(sock, 404, "Not Found", "{\"erro\":\"rota desconhecida\"}");
	}

	/* Mostra só a primeira linha da requisição */
	printk("HTTP: %.*s -> %d\r\n", (int)strcspn(req, "\r\n"), req, codigo);
	return reiniciar;
}

static void reiniciar_placa(void)
{
	printk("HTTP: reset pedido, reiniciando\r\n");

	/* Não deixa o reboot cortar uma linha do CSV no meio */
	armazenamento_finalizar();

	/* Tempo para o TCP entregar a resposta e o FIN ao supervisor */
	k_sleep(K_MSEC(200));
	sys_reboot(SYS_REBOOT_COLD);
}

static void servidor_http(void *p1, void *p2, void *p3)
{
	struct net_sockaddr_in addr = {
		.sin_family = NET_AF_INET,
		.sin_port = net_htons(CONFIG_SERVIDOR_HTTP_PORTA),
		/* sin_addr zerado = qualquer IP da placa */
	};
	struct zsock_timeval tv = { .tv_sec = TIMEOUT_RECV_S };
	int escuta;

	ARG_UNUSED(p1);
	ARG_UNUSED(p2);
	ARG_UNUSED(p3);

	escuta = zsock_socket(NET_AF_INET, NET_SOCK_STREAM, NET_IPPROTO_TCP);
	if (escuta < 0) {
		printk("HTTP: falha ao criar o socket (%d)\r\n", -errno);
		return;
	}

	if (zsock_bind(escuta, (struct net_sockaddr *)&addr, sizeof(addr)) < 0 ||
	    zsock_listen(escuta, 2) < 0) {
		printk("HTTP: falha ao abrir a porta %d (%d)\r\n",
		       CONFIG_SERVIDOR_HTTP_PORTA, -errno);
		zsock_close(escuta);
		return;
	}

	printk("HTTP: escutando na porta %d\r\n", CONFIG_SERVIDOR_HTTP_PORTA);

	for (;;) {
		int cliente = zsock_accept(escuta, NULL, NULL);
		bool reiniciar;

		if (cliente < 0) {
			k_sleep(K_MSEC(100));
			continue;
		}

		/* Cliente que conecta e não manda nada não trava o servidor */
		zsock_setsockopt(cliente, ZSOCK_SOL_SOCKET, ZSOCK_SO_RCVTIMEO,
				 &tv, sizeof(tv));
		reiniciar = atender(cliente);
		zsock_close(cliente);

		if (reiniciar) {
			reiniciar_placa();
		}
	}
}

void api_http_iniciar(void)
{
	k_thread_create(&thread_http, pilha_http, K_THREAD_STACK_SIZEOF(pilha_http),
			servidor_http, NULL, NULL, NULL, PRIORIDADE, 0, K_NO_WAIT);
	k_thread_name_set(&thread_http, "http");
}
```

## src/rede.c
```c
#include "rede.h"

#include <zephyr/net/net_if.h>
#include <zephyr/net/net_ip.h>
#include <zephyr/net/net_mgmt.h>
#include <zephyr/net/net_event.h>
#include <zephyr/sys/printk.h>
#include <string.h>

static struct net_mgmt_event_callback net_cb;
static K_SEM_DEFINE(ip_pronto, 0, 1);

static bool mostrar_ipv4(struct net_if *iface)
{
	struct net_in_addr *addr;
	char texto[NET_IPV4_ADDR_LEN];

	addr = net_if_ipv4_get_global_addr(iface, NET_ADDR_PREFERRED);
	if (addr == NULL) {
		return false;
	}

	net_addr_ntop(AF_INET, addr, texto, sizeof(texto));
	printk("Rede: IP %s\r\n", texto);
	return true;
}

static void net_event_handler(struct net_mgmt_event_callback *cb,
			      uint64_t event, struct net_if *iface)
{
	ARG_UNUSED(cb);
	ARG_UNUSED(iface);

	if (event == NET_EVENT_IPV4_ADDR_ADD) {
		k_sem_give(&ip_pronto);
	}
}

void rede_iniciar(void)
{
	struct net_if *iface = net_if_get_default();


	net_mgmt_init_event_callback(&net_cb, net_event_handler,
				     NET_EVENT_IPV4_ADDR_ADD);
	net_mgmt_add_event_callback(&net_cb);

	if (iface != NULL) {
		int up_ret = net_if_up(iface);

		/* Aplica o IP estatico (se configurado) a interface */
		if (strlen(CONFIG_NET_CONFIG_MY_IPV4_ADDR) > 0) {
			struct in_addr addr;
			struct in_addr netmask;
			struct net_if_addr *ifaddr;

			net_addr_pton(AF_INET, CONFIG_NET_CONFIG_MY_IPV4_ADDR, &addr);
			net_addr_pton(AF_INET, CONFIG_NET_CONFIG_MY_IPV4_NETMASK, &netmask);
			ifaddr = net_if_ipv4_addr_add(iface, &addr, NET_ADDR_MANUAL, 0);
			net_if_ipv4_set_netmask_by_addr(iface, &addr, &netmask);
		}
	}
}

int rede_aguardar_ip(k_timeout_t timeout)
{
	struct net_if *iface = net_if_get_default();

	/* O DHCP pode ter terminado antes de o callback ser registrado */
	if (mostrar_ipv4(iface)) {
		return 0;
	}

	if (k_sem_take(&ip_pronto, timeout) < 0) {
		return -EAGAIN;
	}

	mostrar_ipv4(iface);
	return 0;
}
```
